## sdkconfig.defaults
```kconfig
CONFIG_IDF_TARGET="esp32c3"
CONFIG_ESPTOOLPY_FLASHSIZE_16MB=y
CONFIG_ESPTOOLPY_FLASHSIZE="16MB"
CONFIG_ESPTOOLPY_FLASHMODE_DIO=y
CONFIG_ESPTOOLPY_FLASHMODE="dio"
CONFIG_PARTITION_TABLE_CUSTOM=y
CONFIG_PARTITION_TABLE_CUSTOM_FILENAME="/home/lzh/Projects/rr_x4_firmware/rr_reader/partitions.csv"
CONFIG_PARTITION_TABLE_FILENAME="/home/lzh/Projects/rr_x4_firmware/rr_reader/partitions.csv"
CONFIG_PARTITION_TABLE_OFFSET=0x8000

# 极限内存优化
CONFIG_ESP_MAIN_TASK_STACK_SIZE=49152
CONFIG_ESP_SYSTEM_EVENT_TASK_STACK_SIZE=2048
CONFIG_ESP_TIMER_TASK_STACK_SIZE=2048
CONFIG_PTHREAD_TASK_STACK_SIZE_DEFAULT=2048

# 日志优化
CONFIG_LOG_DEFAULT_LEVEL_WARN=y
CONFIG_LOG_MAXIMUM_LEVEL_WARN=y

# 禁用不必要的功能
CONFIG_ESP_CONSOLE_USB_SERIAL_JTAG=y

# FATFS优化 - 使用栈而非堆
CONFIG_FATFS_LFN_STACK=y
CONFIG_FATFS_MAX_LFN=127
CONFIG_FATFS_API_ENCODING_UTF_8=y
CONFIG_FATFS_CODEPAGE_936=y

# WiFi优化
CONFIG_ESP32_WIFI_STATIC_RX_BUFFER_NUM=2
CONFIG_ESP32_WIFI_DYNAMIC_RX_BUFFER_NUM=3
CONFIG_ESP32_WIFI_TX_BUFFER_TYPE=1
CONFIG_ESP32_WIFI_DYNAMIC_TX_BUFFER_NUM=3
CONFIG_ESP32_WIFI_AMPDU_TX_ENABLED=n
CONFIG_ESP32_WIFI_AMPDU_RX_ENABLED=n

# LWIP优化
CONFIG_LWIP_MAX_SOCKETS=2
CONFIG_LWIP_TCPIP_RECVMBOX_SIZE=4
CONFIG_LWIP_TCP_RECVMBOX_SIZE=4
CONFIG_LWIP_UDP_RECVMBOX_SIZE=4
CONFIG_LWIP_TCP_SND_BUF_DEFAULT=4096
CONFIG_LWIP_TCP_WND_DEFAULT=4096

CONFIG_MBEDTLS_SSL_IN_CONTENT_LEN=16384
CONFIG_MBEDTLS_SSL_OUT_CONTENT_LEN=4096
CONFIG_MBEDTLS_DYNAMIC_BUFFER=y
CONFIG_MBEDTLS_DYNAMIC_FREE_CA_CERT=y
CONFIG_MBEDTLS_HKDF_C=n
CONFIG_MBEDTLS_GENPRIME_C=n
CONFIG_MBEDTLS_PKCS5_C=n
CONFIG_MBEDTLS_PKCS12_C=n
CONFIG_MBEDTLS_X509_CRT_PARSE_C=n
CONFIG_MBEDTLS_X509_CRL_PARSE_C=n
CONFIG_MBEDTLS_X509_CSR_PARSE_C=n
CONFIG_MBEDTLS_ERROR_C=n
CONFIG_MBEDTLS_SELF_TEST=n
CONFIG_MBEDTLS_VERSION_C=n
CONFIG_MBEDTLS_SSL_KEEP_PEER_CERTIFICATE=n
CONFIG_MBEDTLS_SSL_PROTO_TLS1_3=n
CONFIG_MBEDTLS_SSL_PROTO_DTLS=n

# FreeRTOS优化
CONFIG_FREERTOS_PLACE_FUNCTIONS_INTO_FLASH=y
CONFIG_FREERTOS_IDLE_TASK_STACKSIZE=1024
CONFIG_FREERTOS_ISR_STACKSIZE=1536

# 编译器优化
CONFIG_COMPILER_OPTIMIZATION_SIZE=y
CONFIG_COMPILER_OPTIMIZATION_ASSERTIONS_DISABLE=y
```
